## sdkconfig.defaults
```kconfig
# ESP-IDF SDK configuration
# This file is read by the esp-idf-sys build script.

# Increase the main task stack size for Rust.
CONFIG_ESP_MAIN_TASK_STACK_SIZE=8192

# SPI flash
CONFIG_ESPTOOLPY_FLASHSIZE_16MB=y
CONFIG_ESPTOOLPY_FLASHSIZE="16MB"
# This ESP32-S3 board's embedded flash fails to boot reliably with DIO/40 MHz.
# DOUT/20 MHz lets the ROM bootloader read the second-stage bootloader cleanly.
CONFIG_ESPTOOLPY_FLASHMODE_DOUT=y
CONFIG_ESPTOOLPY_FLASHMODE="dout"
CONFIG_ESPTOOLPY_FLASHFREQ_20M=y
CONFIG_ESPTOOLPY_FLASHFREQ="20m"

# Bluetooth is not needed; save RAM.
CONFIG_BT_ENABLED=n

# Log level: use Info while debugging; Warn is suitable for release builds.
CONFIG_LOG_DEFAULT_LEVEL_INFO=y

# HTTPS health check needs trusted root certificates.
CONFIG_MBEDTLS_CERTIFICATE_BUNDLE=y
CONFIG_MBEDTLS_CERTIFICATE_BUNDLE_DEFAULT_FULL=y
```
